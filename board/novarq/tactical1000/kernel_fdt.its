## board/novarq/tactical1000/kernel_fdt.its
```
/*
 * U-Boot FIT image containing a kernel, FDT, and optional PoE overlay
 */

/dts-v1/;

/ {
	description = "LAN969x kernel and FDT blob";
	#address-cells = <1>;

	images {
		kernel {
			description = "LAN969x Linux kernel";
			data = /incbin/("Image.gz");
			type = "kernel";
			arch = "arm64";
			os = "linux";
			compression = "gzip";
			load = <0x60000000>;
			entry = <0x60000000>;
			hash-1 {
				algo = "crc32";
			};
			hash-2 {
				algo = "sha1";
			};
		};
		fdt-1 {
			description = "Flattened Device Tree blob";
			data = /incbin/("lan9696-tactical-1000.dtb");
			type = "flat_dt";
			arch = "arm64";
			compression = "none";
			hash-1 {
				algo = "crc32";
			};
			hash-2 {
				algo = "sha1";
			};
		};
		fdt-poe {
			description = "Tactical 1000 PoE overlay";
			data = /incbin/("lan9696-tactical-1000-poe.dtbo");
			type = "flat_dt";
			arch = "arm64";
			compression = "none";
			hash-1 {
				algo = "crc32";
			};
			hash-2 {
				algo = "sha1";
			};
		};
	};

	configurations {
		default = "conf-1";
		conf-1 {
			description = "Boot Linux kernel with FDT blob";
			kernel = "kernel";
			fdt = "fdt-1";
		};
		conf-poe {
			description = "Boot Linux kernel with PoE overlay";
			kernel = "kernel";
			fdt = "fdt-1", "fdt-poe";
		};
	};
};
```
